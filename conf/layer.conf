## conf/layer.conf
```bitbake
# We have a conf and classes directory, add to BBPATH
BBPATH .= ":${LAYERDIR}"

# We have recipes-* directories, add to BBFILES
BBFILES += "${LAYERDIR}/recipes-*/*/*.bb \
            ${LAYERDIR}/recipes-*/*/*.bbappend"

BBFILE_COLLECTIONS += "meta-curiosis"
BBFILE_PATTERN_meta-curiosis = "^${LAYERDIR}/"
BBFILE_PRIORITY_meta-curiosis = "9"

LAYERDEPENDS_meta-curiosis = "core"
LAYERSERIES_COMPAT_meta-curiosis = "kirkstone"
```

## conf/machine/curiosis-imx8mm.conf
```bitbake
#@TYPE: Machine
#@NAME: CURIOSIS-IMX8MM
#@SOC: i.MX8MM
#@DESCRIPTION: Machine configuration for TechNexion EDM-G-IMX8MM
#@MAINTAINER: UCY <cyum@curiosis.com>

MACHINEOVERRIDES =. "imx-boot-container:mx8mm:"

#PREFERRED_VERSION:linux-yocto = "5.0%"

require conf/machine/include/imx-base.inc
require conf/machine/include/arm/armv8a/tune-cortexa53.inc
require conf/machine/tn-base.inc

# Kernel specifics
KERNEL_DEVICETREE ?= " freescale/imx8mm-edm-g-wb.dtb freescale/overlays/imx8mm-edm-g-wb-sn65dsi84-vl10112880.dtbo"
#KERNEL_DEVICETREE ?= " freescale/imx8mm-curiosis.dtb "
KERNEL_MODULE_AUTOLOAD += "imx_rpmsg_tty"

EXTRA_OEMAKE:append:pn-linux-tn-imx = " DTC_FLAGS='-@ -H epapr'"

# U-boot specifics
UBOOT_CONFIG[sd] = "edm-g-imx8mm_defconfig,sdcard"
UBOOT_CONFIG[mfgtool] = "edm-g-imx8mm_defconfig"
UBOOT_DTB_NAME = "imx8mm-edm-g-wb.dtb"

#UBOOT_CONFIG[sd] = "curiosis-imx8mm_defconfig,sdcard"
#UBOOT_CONFIG[mfgtool] = "curiosis-imx8mm_defconfig"
#UBOOT_DTB_NAME = "imx8mm-curiosis.dtb"

ATF_PLATFORM = "imx8mm"
ATF_LOAD_ADDR = "0x920000"

# Extra firmware package name, that is required to build boot container for fslc bsp
IMX_EXTRA_FIRMWARE = "firmware-imx-8m"
IMX_BOOT_SOC_TARGET = "iMX8MM"

# Set Serial console
SERIAL_CONSOLE = "115200;ttymxc1"
SERIAL_BLUETOOTH = "3000000;ttymxc2"

BOOT_SPACE = "65536"

# WIC Image
WKS_FILE:virtualization = "tn-imx8-imxboot-rootfs-container.wks.in"
WIC_FSTAB_BLKDEV = "mmcblk2"
WIC_CREATE_EXTRA_ARGS:remove:virtualization = "--no-fstab-update"
WIC_PARTITION_TABLE_TYPE ?= "msdos"
IMAGE_FSTYPES:append:virtualization = " wic"
IMAGE_FSTYPES:remove:virtualization = " sdcard sdcard.bz2 sdcard.xz sdcard.md5sum "

IMAGE_BOOT_FILES += "\
                    imx8mm_m4_TCM_hello_world.bin \
                    imx8mm_m4_TCM_rpmsg_lite_pingpong_rtos_linux_remote.bin \
                    imx8mm_m4_TCM_rpmsg_lite_str_echo_rtos.bin \
"
# virtualization - docker containers
#DOCKERDISKDEPENDS = "${@bb.utils.contains('DISTRO_FEATURES', 'virtualization', 'docker-disk:do_deploy', '', d)}"
#do_image_wic[depends] += "${DOCKERDISKDEPENDS}"
#TN_DOCKER_PARTITION_IMAGE = "docker-data-partition.img"
#TN_DOCKER_PARTITION_MOUNT = "/var/lib/docker"
#TN_DOCKER_PARTITION_SIZE = "4096"

ERROR_QA:remove = "version-going-backwards"
```
